## examples/sample_project/arch/arm/Kconfig
```kconfig
config ARM
	bool "ARM architecture"
	default n
	help
	  Support for ARM architecture.

config ARM64
	bool "64-bit ARM support"
	depends on ARM
	default n
```

## examples/sample_project/kernel/Kconfig
```kconfig
config KERNEL_VERSION
	string "Kernel version"
	default "1.0.0"

config PREEMPT
	bool "Preemptible kernel"
	default n
	help
	  Enable kernel preemption.

config ADVANCED_FEATURES
	bool "Advanced kernel features"
	default n
	help
	  Enable advanced kernel features.

config SCHEDULER_RT
	bool "Real-time scheduler"
	depends on ADVANCED_FEATURES
	select PREEMPT
	help
	  Enable real-time scheduler support.
	  This automatically enables kernel preemption.

config MEMORY_HOTPLUG
	bool "Memory hotplug support"
	depends on ADVANCED_FEATURES
	help
	  Support for hot-plugging memory modules.

config PROFILING
	bool "Profiling support"
	imply ADVANCED_FEATURES
	help
	  Enable kernel profiling.
	  This implies advanced features but doesn't require them.
```
